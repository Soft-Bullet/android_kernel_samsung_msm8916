## arch/arm/configs/msm8916_sec_a53g_eur_defconfig
```kconfig
CONFIG_SEC_A53G_EUR_PROJECT=y
CONFIG_MACH_A53G_EUR_OPEN=y

CONFIG_SEC_GPIO_SETTINGS=y
# MUIC
CONFIG_SM5502_MUIC=y
CONFIG_MUIC_SUPPORT_RUSTPROOF_INBATT=y
CONFIG_USBID_STANDARD_VER_01=y
CONFIG_MUIC_SUPPORT_CHARGING_CABLE=y

#HALL IC
CONFIG_SENSORS_HALL=y

#DISPLAY
CONFIG_PANEL_EA8061V_AMS497EE01_HD=y

#Touch Key
CONFIG_INPUT_ENABLED=y
CONFIG_KEYBOARD_ABOV_TOUCH_A5=y

#Touch Screen
#CONFIG_TOUCHSCREEN_MMS300_A=y
CONFIG_TOUCHSCREEN_MMS300=y

# VIBRATOR
CONFIG_MSM_VIBRATOR=y

# Battery
CONFIG_MFD_RT5033=y
CONFIG_MFD_RT5033_RESET_GPIO=y
CONFIG_MFD_RT5033_SLDO_VBUSDET=n
CONFIG_BATTERY_SAMSUNG=y
CONFIG_BATTERY_SAMSUNG_DATA_FILE="a5_battery_data.h"
CONFIG_SAMSUNG_LPM_MODE=y
CONFIG_CHARGER_RT5033=y
CONFIG_FUELGAUGE_RT5033=y
CONFIG_REGULATOR_RT5033=y
CONFIG_BATTERY_SWELLING=y

#SENSORS
CONFIG_SENSORS=y
CONFIG_SENSORS_CORE=y
CONFIG_SENSORS_TMD3782S_VDD_LEDA=y
CONFIG_SENSORS_TMD3782S=y
CONFIG_SENSORS_BMC150_VDD=y
# BMC150
CONFIG_SENSORS_BMA2X2=y
CONFIG_SENSORS_BMM050=y
CONFIG_SENSORS_BMA2X2_ENABLE_INT1=y
CONFIG_SENSORS_ACCELEROMETER_2G=y

CONFIG_NFC_PN547=y
CONFIG_NFC_PN547_8916_USE_BBCLK2=y

#AUDIO
CONFIG_RADIO_IRIS=y
CONFIG_RADIO_IRIS_TRANSPORT=m
CONFIG_AUDIO_SPEAKER_OUT_NXP_AMP_ENABLE=y
CONFIG_AUDIO_QUAT_I2S_ENABLE=y

#MMC
CONFIG_SEC_HYBRID_TRAY=y

#FLASH
CONFIG_FLASHLIGHT=y
CONFIG_RT_FLASH_LED=y
CONFIG_FLED_RT5033=y
CONFIG_FLED_RT5033_EXT_GPIO=y

#CAMERA
CONFIG_IMX135=y
CONFIG_S5K5E3YX=y

#optimize mmc block delay on resume
CONFIG_MMC_BLOCK_DEFERRED_RESUME=y

#DUAL SIM / SINGLE SIM Detection
CONFIG_CHECK_SIMSLOT_COUNT=y
CONFIG_CHECK_SIMSLOT_COUNT_DT=y

# SSWAP
CONFIG_SWAP=y
CONFIG_FRONTSWAP=y
CONFIG_ZSMALLOC=y
CONFIG_PGTABLE_MAPPING=y
CONFIG_ZSWAP=y
CONFIG_DIRECT_RECLAIM_FILE_PAGES_ONLY=y
CONFIG_INCREASE_MAXIMUM_SWAPPINESS=y
CONFIG_FIX_INACTIVE_RATIO=y
CONFIG_TIGHT_PGDAT_BALANCE=y
CONFIG_VNSWAP=y
CONFIG_SWAP_ENABLE_READAHEAD=n
```
